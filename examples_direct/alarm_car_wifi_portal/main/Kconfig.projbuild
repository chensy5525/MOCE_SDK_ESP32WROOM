## examples_direct/alarm_car_wifi_portal/main/Kconfig.projbuild
```kconfig
menu "Alarm car Wi-Fi portal"

config ALARM_CAR_PORTAL_AP_SSID
    string "SoftAP SSID"
    default "MOCE-AlarmCar"

config ALARM_CAR_PORTAL_AP_PASSWORD
    string "SoftAP password (8-63 characters)"
    default "mocemoce"

config ALARM_CAR_PORTAL_MAX_CONNECTIONS
    int "Maximum SoftAP stations"
    range 1 4
    default 4

config ALARM_CAR_STA_SSID
    string "Upstream Wi-Fi SSID (empty disables SNTP)"
    default ""

config ALARM_CAR_STA_PASSWORD
    string "Upstream Wi-Fi password (not logged)"
    default ""

config ALARM_CAR_STA_MAXIMUM_RETRIES
    int "Station retries per connection round"
    range 1 20
    default 5

config ALARM_CAR_STA_IP_WAIT_TIMEOUT_MS
    int "Station IP wait timeout (ms)"
    range 1000 120000
    default 15000

config ALARM_CAR_SNTP_SERVER
    string "SNTP server"
    default "pool.ntp.org"

config ALARM_CAR_SNTP_SYNC_TIMEOUT_MS
    int "SNTP first-sync timeout (ms)"
    range 1000 120000
    default 15000

config ALARM_CAR_SNTP_RETRY_INTERVAL_MS
    int "SNTP retry interval (ms)"
    range 1000 600000
    default 30000

config ALARM_CAR_SNTP_CALIBRATION_PERIOD_SECONDS
    int "Successful SNTP calibration period (seconds)"
    range 60 86400
    default 21600

config ALARM_CAR_UTC_OFFSET_MINUTES
    int "Local offset from UTC (minutes)"
    range -720 840
    default 480

config ALARM_CAR_NETWORK_TIME_TASK_STACK_SIZE
    int "Network time task stack size"
    range 3072 8192
    default 4096

config ALARM_CAR_SCHEDULER_TASK_STACK_SIZE
    int "Alarm scheduler task stack size"
    range 3072 8192
    default 4096

endmenu
```

## examples_direct/max98357a_flash_mp3_test/sdkconfig.defaults
```kconfig
CONFIG_IDF_TARGET="esp32"
CONFIG_ESPTOOLPY_FLASHSIZE_4MB=y
CONFIG_PARTITION_TABLE_CUSTOM=y
CONFIG_PARTITION_TABLE_CUSTOM_FILENAME="partitions.csv"
CONFIG_PARTITION_TABLE_FILENAME="partitions.csv"

CONFIG_AUDIO_DECODER_MP3_SUPPORT=y
# CONFIG_AUDIO_DECODER_AAC_SUPPORT is not set
# CONFIG_AUDIO_DECODER_G711_SUPPORT is not set
# CONFIG_AUDIO_DECODER_AMRNB_SUPPORT is not set
# CONFIG_AUDIO_DECODER_AMRWB_SUPPORT is not set
# CONFIG_AUDIO_DECODER_FLAC_SUPPORT is not set
# CONFIG_AUDIO_DECODER_OPUS_SUPPORT is not set
# CONFIG_AUDIO_DECODER_VORBIS_SUPPORT is not set
# CONFIG_AUDIO_DECODER_ADPCM_SUPPORT is not set
# CONFIG_AUDIO_DECODER_ALAC_SUPPORT is not set
# CONFIG_AUDIO_DECODER_PCM_SUPPORT is not set
# CONFIG_AUDIO_DECODER_SBC_SUPPORT is not set
# CONFIG_AUDIO_DECODER_LC3_SUPPORT is not set
# CONFIG_AUDIO_DECODER_G722_SUPPORT is not set
# CONFIG_AUDIO_SIMPLE_DEC_WAV_SUPPORT is not set
# CONFIG_AUDIO_SIMPLE_DEC_M4A_SUPPORT is not set
# CONFIG_AUDIO_SIMPLE_DEC_TS_SUPPORT is not set
# CONFIG_AUDIO_SIMPLE_DEC_OGG_SUPPORT is not set
# CONFIG_AUDIO_ENCODER_AAC_SUPPORT is not set
# CONFIG_AUDIO_ENCODER_G711_SUPPORT is not set
# CONFIG_AUDIO_ENCODER_AMRNB_SUPPORT is not set
# CONFIG_AUDIO_ENCODER_AMRWB_SUPPORT is not set
# CONFIG_AUDIO_ENCODER_OPUS_SUPPORT is not set
# CONFIG_AUDIO_ENCODER_ADPCM_SUPPORT is not set
# CONFIG_AUDIO_ENCODER_ALAC_SUPPORT is not set
# CONFIG_AUDIO_ENCODER_PCM_SUPPORT is not set
# CONFIG_AUDIO_ENCODER_SBC_SUPPORT is not set
# CONFIG_AUDIO_ENCODER_LC3_SUPPORT is not set
# CONFIG_AUDIO_ENCODER_G722_SUPPORT is not set
```

## examples_direct/wifi_alarm_portal_test/main/Kconfig.projbuild
```kconfig
menu "Alarm portal test"

config ALARM_PORTAL_AP_SSID
    string "SoftAP SSID"
    default "AlarmCar-06"

config ALARM_PORTAL_AP_PASSWORD
    string "SoftAP password (empty or 8-63 characters)"
    default "alarmcar06"

endmenu
```
